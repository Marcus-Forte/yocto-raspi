## meta-hello/conf/distro/marcus.conf
```bitbake
DISTRO = "marcus"
DISTRO_NAME = "Marcus Distro"

DISTRO_VERSION = "0.1"
DISTRO_CODENAME = "loira"

TCLIBCAPPEND = ""

DISTRO_FEATURES = "${DISTRO_FEATURES_DEFAULT} systemd "
DISTRO_FEATURES_BACKFILL_CONSIDERED = "sysvinit"
INIT_MANAGER = "systemd"
VIRTUAL-RUNTIME_init_manager = "systemd"
VIRTUAL-RUNTIME_initscripts = ""
```

## meta-simple/conf/distro/simple.conf
```bitbake
DISTRO_NAME = "Marcus Distro"

DISTRO_VERSION = "0.1"
DISTRO_CODENAME = "Loira"

LICENSE_FLAGS_ACCEPTED = "synaptics-killswitch"

DISTRO_FEATURES = "${DISTRO_FEATURES_DEFAULT} wifi bluetooth"

ENABLE_I2C = "1"
KERNEL_MODULE_AUTOLOAD:rpi += "i2c-dev i2c-bcm2708"
DISTRO_FEATURES:append = " systemd usrmerge systemd-resolved virtualization docker"
DISTRO_FEATURES_BACKFILL_CONSIDERED += "sysvinit"
VIRTUAL-RUNTIME_init_manager = "systemd"
VIRTUAL-RUNTIME_initscripts = "systemd-compat-units"

PACKAGECONFIG:pn-hellocmake = "CONFIG_A"

IMAGE_INSTALL:append = " docker hellocmake git ldd i2c-tools util-linux vim wpa-supplicant my-eth my-wifi"
IMAGE_INSTALL:raspberrypi5:append = " linux-firmware-rtl8821 packagegroup-core-boot packagegroup-rpi-test"
# TODO why is `packagegroup-core-boot` no longer present when using :<machine>:append.

# Console only
DISTRO_FEATURES:remove = "x11 opengl"

WKS_FILE = "my-img.wks"
```

## meta-simple/conf/layer.conf
```bitbake
# We have a conf and classes directory, add to BBPATH
BBPATH .= ":${LAYERDIR}"

# We have recipes-* directories, add to BBFILES
BBFILES += "${LAYERDIR}/recipes-*/*/*.bb \
            ${LAYERDIR}/recipes-*/*/*.bbappend"

BBFILE_COLLECTIONS += "meta-simple"
BBFILE_PATTERN_meta-simple = "^${LAYERDIR}/"
BBFILE_PRIORITY_meta-simple = "6"

LAYERDEPENDS_meta-simple = "core"
LAYERSERIES_COMPAT_meta-simple = "styhead"

BBFILES_DYNAMIC += "\
    tegra:${LAYERDIR}/dynamic-layers/recipes-bsp/u-boot/*.bbappend \
    raspberrypi:${LAYERDIR}/dynamic-layers/recipes-kernel/linux/linux-raspberrypi_%.bbappend \
"
```
